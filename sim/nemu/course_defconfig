## sim/nemu/course_defconfig
```kconfig
CONFIG_ISA_riscv=y
# CONFIG_RV64 is not set
# CONFIG_RVE is not set
CONFIG_ENGINE_INTERPRETER=y
CONFIG_MODE_SYSTEM=y
CONFIG_TARGET_NATIVE_ELF=y
CONFIG_CC_GCC=y
CONFIG_CC_O2=y
# CONFIG_TRACE is not set
# CONFIG_DIFFTEST is not set
CONFIG_MBASE=0x0
CONFIG_MSIZE=0x400000
CONFIG_PC_RESET_OFFSET=0
CONFIG_PMEM_GARRAY=y
# CONFIG_MEM_RANDOM is not set
# CONFIG_DEVICE is not set
CONFIG_TIMER_GETTIMEOFDAY=y
CONFIG_RT_CHECK=y
```
